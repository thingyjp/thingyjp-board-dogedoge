## software/dogedoge-buildroot/board/thingyjp/dogedoge/firmwareimage.its
```
/dts-v1/;

/ {
	description = "dogedoge firmware";
	#address-cells = <1>;

	images {
		kernel@1 {
			data = /incbin/("../../images/zImage");
			type = "kernel";
			arch = "arm";
			os = "linux";
			compression = "none";
			load = <0x41000000>;
			entry = <0x41000000>;
			hash@1 {
				algo = "crc32";
			};
			hash@2 {
				algo = "sha1";
			};
		};
		fdt@1 {
			data = /incbin/("../../images/sun8i-v3s-dogedoge.dtb");
			type = "flat_dt";
			arch = "arm";
			load = <0x41800000>;
			compression = "none";
			hash@1 {
				algo = "crc32";
			};
			hash@2 {
				algo = "sha1";
			};
		};
		ramdisk@1 {
			data = /incbin/("../../images/rootfs.squashfs");
			type = "ramdisk";
			arch = "arm";
			os = "linux";
			#load = <0x41B00000>;
			compression = "none";
			hash@1 {
				algo = "crc32";
			};
			hash@2 {
				algo = "sha1";
			};
		};
	};

	configurations {
		default = "conf@1";
		conf@1 {
			kernel = "kernel@1";
			fdt = "fdt@1";
			ramdisk = "ramdisk@1";
		};
	};
};
```

## software/dogedoge-buildroot/configs/dogedoge_flasher_defconfig
```kconfig
BR2_arm=y
BR2_cortex_a7=y
BR2_ARM_FPU_NEON_VFPV4=y
BR2_CCACHE=y
BR2_TOOLCHAIN_BUILDROOT_GLIBC=y
BR2_BINUTILS_VERSION_2_28_X=y
BR2_GCC_VERSION_8_X=y
BR2_GCC_ENABLE_LTO=y
# BR2_TARGET_GENERIC_REMOUNT_ROOTFS_RW is not set
BR2_ROOTFS_POST_BUILD_SCRIPT="$(BR2_EXTERNAL_DOGEDOGE_PATH)/preimage_embedfirmware.sh $(BR2_EXTERNAL_DOGEDOGE_PATH)/preimage_embedubootscript.sh"
BR2_ROOTFS_POST_IMAGE_SCRIPT="support/scripts/genimage.sh"
BR2_ROOTFS_POST_SCRIPT_ARGS="-c $(BR2_EXTERNAL_DOGEDOGE_PATH)/board/thingyjp/dogedoge_flasher/genimage.cfg"
BR2_LINUX_KERNEL=y
BR2_LINUX_KERNEL_CUSTOM_GIT=y
BR2_LINUX_KERNEL_CUSTOM_REPO_URL="https://github.com/fifteenhex/linux"
BR2_LINUX_KERNEL_CUSTOM_REPO_VERSION="cywfmac_v4.18"
BR2_LINUX_KERNEL_USE_CUSTOM_CONFIG=y
BR2_LINUX_KERNEL_CUSTOM_CONFIG_FILE="$(BR2_EXTERNAL_DOGEDOGE_PATH)/board/thingyjp/dogedoge/kernel.config"
BR2_LINUX_KERNEL_CONFIG_FRAGMENT_FILES="$(BR2_EXTERNAL_THINGYJP_PATH)/kernelconfigsnippets/wifi-brcm-sdio.config"
BR2_LINUX_KERNEL_XZ=y
BR2_LINUX_KERNEL_DTS_SUPPORT=y
BR2_LINUX_KERNEL_CUSTOM_DTS_PATH="$(BR2_EXTERNAL_DOGEDOGE_PATH)/board/thingyjp/dogedoge/sun8i-v3s-dogedoge.dts"
BR2_LINUX_KERNEL_INSTALL_TARGET=y
BR2_PACKAGE_BUSYBOX_WATCHDOG=y
BR2_PACKAGE_MTD=y
# BR2_PACKAGE_MTD_NANDDUMP is not set
# BR2_PACKAGE_MTD_NANDTEST is not set
# BR2_PACKAGE_MTD_NANDWRITE is not set
# BR2_PACKAGE_MTD_UBIATTACH is not set
# BR2_PACKAGE_MTD_UBICRC32 is not set
# BR2_PACKAGE_MTD_UBIDETACH is not set
# BR2_PACKAGE_MTD_UBIFORMAT is not set
# BR2_PACKAGE_MTD_UBIMKVOL is not set
# BR2_PACKAGE_MTD_UBINFO is not set
# BR2_PACKAGE_MTD_UBINIZE is not set
# BR2_PACKAGE_MTD_UBIRENAME is not set
# BR2_PACKAGE_MTD_UBIRMVOL is not set
# BR2_PACKAGE_MTD_UBIRSVOL is not set
# BR2_PACKAGE_MTD_UBIUPDATEVOL is not set
# BR2_PACKAGE_MTD_UBIBLOCK is not set
BR2_PACKAGE_LINUX_FIRMWARE=y
BR2_PACKAGE_LINUX_FIRMWARE_BRCM_BCM43XXX=y
# BR2_PACKAGE_LINUX_FIRMWARE_BRCM_BCM43XXX_OTHERS is not set
BR2_PACKAGE_LINUX_FIRMWARE_BRCM_BCM43XXX_BCM43430_SDIO_AP6212=y
BR2_PACKAGE_STM32FLASH=y
BR2_PACKAGE_PYTHON3_PYEXPAT=y
BR2_PACKAGE_PYTHON3_ZLIB=y
BR2_PACKAGE_LZO=y
# BR2_PACKAGE_IFUPDOWN_SCRIPTS is not set
BR2_PACKAGE_IW=y
BR2_PACKAGE_WIRELESS_REGDB=y
BR2_PACKAGE_WPA_SUPPLICANT=y
BR2_PACKAGE_WPA_SUPPLICANT_AP_SUPPORT=y
BR2_PACKAGE_WPA_SUPPLICANT_CLI=y
BR2_TARGET_ROOTFS_EXT2=y
BR2_TARGET_ROOTFS_EXT2_4=y
BR2_TARGET_ROOTFS_EXT2_SIZE="128M"
# BR2_TARGET_ROOTFS_TAR is not set
BR2_TARGET_UBOOT=y
BR2_TARGET_UBOOT_BUILD_SYSTEM_KCONFIG=y
BR2_TARGET_UBOOT_CUSTOM_GIT=y
BR2_TARGET_UBOOT_CUSTOM_REPO_URL="https://github.com/fifteenhex/u-boot.git"
BR2_TARGET_UBOOT_CUSTOM_REPO_VERSION="dogedoge"
BR2_TARGET_UBOOT_BOARD_DEFCONFIG="dogedoge"
BR2_TARGET_UBOOT_CONFIG_FRAGMENT_FILES="$(BR2_EXTERNAL_DOGEDOGE_PATH)/board/thingyjp/dogedoge_flasher/uboot/overrideenv.config"
BR2_TARGET_UBOOT_NEEDS_PYLIBFDT=y
# BR2_TARGET_UBOOT_FORMAT_BIN is not set
BR2_TARGET_UBOOT_FORMAT_CUSTOM=y
BR2_TARGET_UBOOT_FORMAT_CUSTOM_NAME="u-boot-sunxi-with-spl.bin"
BR2_TARGET_UBOOT_BOOT_SCRIPT=y
BR2_TARGET_UBOOT_BOOT_SCRIPT_SOURCE="$(BR2_EXTERNAL_DOGEDOGE_PATH)/board/thingyjp/dogedoge_flasher/sdcard.cmd"
BR2_PACKAGE_HOST_GENIMAGE=y
BR2_PACKAGE_CHUM=y
```

## software/dogedoge-buildroot/package/chum/Config.in
```kconfig
config BR2_PACKAGE_CHUM
        bool "chum"
	select BR2_PACKAGE_PYTHON3
        select BR2_PACKAGE_PYTHON_DIALOG3
        help
          Chum
```
